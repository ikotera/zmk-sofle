## Kconfig
```kconfig
config ZMK_LAYER_REPORT
    bool "Report active layer state to host over Raw HID"
    default y
    depends on RAW_HID
```

## config/west.yml
```yaml
manifest:
  remotes:
    - name: zmkfirmware
      url-base: https://github.com/zmkfirmware
    - name: zzeneg
      url-base: https://github.com/zzeneg
  projects:
    - name: zmk
      remote: zmkfirmware
      revision: v0.3
      import: app/west.yml
    # Raw HID（layer-viewer へアクティブレイヤーを通知するため）
    - name: zmk-raw-hid
      remote: zzeneg
      revision: 6a37765dfab6197292e7a9f47305dcf87386d56a
  self:
    path: config
```
